## meta/conf/machine/sm2s-rzg2l.conf
```bitbake
#@TYPE: Machine
#@NAME: smarc-rzg2l machine
#@DESCRIPTION: RZ/G2L SMARC platform

MACHINEOVERRIDES =. "smarc-rzg2l:"

SOC_FAMILY = "r9a07g044l"
require ../../meta-renesas.git/conf/machine/include/rzg2l-common.inc
require ../../meta-renesas.git/conf/machine/include/cip-core.inc

DEFAULTTUNE ?= "cortexa55"

TUNE_CONF ?= "../../meta-renesas.git/conf/machine/include/tune-cortexa55.inc"
require ${TUNE_CONF}

PREFERRED_PROVIDER_virtual/kernel = "linux-renesas"
UBOOT_CONFIG ??= "smarc-rzg2l"
UBOOT_CONFIG[smarc-rzg2l] = "smarc-rzg2l_defconfig"

# flash writer
EXTRA_IMAGEDEPENDS += " flash-writer"
#EXTRA_IMAGEDEPENDS += " u-boot"
#EXTRA_IMAGEDEPENDS += " firmware-pack"
#
#IMAGE_FSTYPES += "wic wic.bmap"

# Supported devicetree
KERNEL_DEVICETREE = " \
        msc/rzg2l/msc-sm2s-g2l-sc-92N0850E-module.dtb \
        msc/rzg2l/overlay-baseboard-ep1.dtb \
        msc/rzg2l/overlay-baseboard-vebo.dtb \
"

ROOTFS_POSTPROCESS_COMMAND_remove += " remove_boot; "

#IMAGE_BOOT_FILES = " \
#        bl2_bp-${MACHINE}.srec \
#        fip-${MACHINE}.srec \
#	Flash_Writer_SCIF_RZV2L_SMARC_PMIC_DDR4_2GB_1PCS.mot \
#"

## Supported devicetree
#KERNEL_DEVICETREE = " \
#	renesas/r9a07g044l2-smarc.dtb \
#"
#
#ROOTFS_POSTPROCESS_COMMAND_remove += " remove_boot; "
```

## meta/conf/machine/sm2s-rzv2l.conf
```bitbake
#@TYPE: Machine
#@NAME: smarc-rzv2l machine
#@DESCRIPTION: RZ/G2L SMARC platform

MACHINEOVERRIDES =. "rzv2l:r9a07g054l:smarc-rzv2l:"

SOC_FAMILY = "r9a07g054l"
require ../../meta-renesas.git/conf/machine/include/rzv2l-common.inc
require ../../meta-renesas.git/conf/machine/include/cip-core.inc

DEFAULTTUNE ?= "cortexa55"

TUNE_CONF ?= "../../meta-renesas.git/conf/machine/include/tune-cortexa55.inc"
require ${TUNE_CONF}

PREFERRED_PROVIDER_virtual/kernel = "linux-renesas"
UBOOT_CONFIG ??= "smarc-rzv2l"
UBOOT_CONFIG[smarc-rzv2l] = "smarc-rzv2l_defconfig"

# flash writer
EXTRA_IMAGEDEPENDS += " flash-writer"
EXTRA_IMAGEDEPENDS += " u-boot"
EXTRA_IMAGEDEPENDS += " firmware-pack"

IMAGE_FSTYPES += "wic wic.bmap"

# Supported devicetree
KERNEL_DEVICETREE = " \
        msc/rzv2l/msc-sm2s-v2l-sc-14N02E1I-module.dtb \
        msc/rzv2l/overlay-baseboard-ep1.dtb \
        msc/rzv2l/overlay-baseboard-vebo.dtb \
	msc/rzv2l/overlay-lvds-ama-101a07.dtb \
"

ROOTFS_POSTPROCESS_COMMAND_remove += " remove_boot; "

IMAGE_BOOT_FILES = " \
        bl2_bp-${MACHINE}.srec \
        fip-${MACHINE}.srec \
	Flash_Writer_SCIF_RZV2L_SMARC_PMIC_DDR4_2GB_1PCS.mot \
"
```

## meta/wic/sm2s-rz-image-bootpart-sd.wks
```
# short-description: Create SD card image with a boot partition
# long-description: Creates a partitioned SD card image. Boot files
# are located in the first vfat partition.

part --source rawcopy --sourceparams="file=bl2_bp_esd-${MACHINE}.bin" --no-table
part --source rawcopy --sourceparams="file=bl2-${MACHINE}.bin" --no-table --align 4
part --source rawcopy --sourceparams="file=fip-${MACHINE}.bin" --no-table --align 64

part /boot --source bootimg-partition --ondisk mmcblk0 --fstype=vfat --label boot --active --align 4
part / --source rootfs --ondisk mmcblk0 --fstype=ext4 --label root --align 4
```
